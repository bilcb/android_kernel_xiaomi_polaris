## Documentation/devicetree/bindings/dma-heap-carveout.txt
```
DMA-BUF carveout heap
======================

A devicetree node with compatible "dma-heap-carveout" binds one
reusable reserved-memory region and exposes it as a dma_heap
(visible as /dev/dma_heap/<heap-name>). This allows reserved pools
that were previously reachable only through ION to be allocated
from generic dma_heap clients as well; both allocators share the
same pool.

Required properties:
- compatible: must be "dma-heap-carveout".
- memory-region: phandle to a reusable reserved-memory region
  (shared-dma-pool) that has a kernel mapping.
- heap-name: string used for the dma_heap name and device node.

Optional properties:
- uncached: if present the heap allocates writecombine (uncached)
  memory; otherwise allocations are cached.

Limitations (by design):
- Regions with "no-map" are refused by the driver; they stay ION-only.
- Secure regions must never be described here; they stay ION-only.

Example:
	dma_heap_adsp: dma-heap-adsp {
		compatible = "dma-heap-carveout";
		memory-region = <&adsp_mem>;
		heap-name = "adsp";
	};
```

## drivers/dma-buf/Kconfig
```kconfig
menu "DMABUF options"

config SYNC_FILE
	bool "Explicit Synchronization Framework"
	default n
	select DMA_SHARED_BUFFER
	---help---
	  The Sync File Framework adds explicit syncronization via
	  userspace. It enables send/receive 'struct fence' objects to/from
	  userspace via Sync File fds for synchronization between drivers via
	  userspace components. It has been ported from Android.

	  The first and main user for this is graphics in which a fence is
	  associated with a buffer. When a job is submitted to the GPU a fence
	  is attached to the buffer and is transferred via userspace, using Sync
	  Files fds, to the DRM driver for example. More details at
	  Documentation/sync_file.txt.

config SW_SYNC
	bool "Sync File Validation Framework"
	default n
	depends on SYNC_FILE
	depends on DEBUG_FS
	---help---
	  A sync object driver that uses a 32bit counter to coordinate
	  synchronization.  Useful when there is no hardware primitive backing
	  the synchronization.

	  WARNING: improper use of this can result in deadlocking kernel
	  drivers from userspace. Intended for test and debug only.

config DMABUF_HEAPS
	bool "DMA-BUF Userland Memory Heaps"
	default y
	select DMA_SHARED_BUFFER
	help
	  Enables the DMA-BUF heaps framework (/dev/dma_heap/*) backported
	  from upstream. Co-exists with ION (/dev/ion): ION stays for legacy
	  HALs (camera/display/audio), dma_heap serves newer userspace
	  (libdmabufheap / GKI-style Gralloc).
	  If unsure, say Y.

config DMABUF_HEAPS_SYSTEM
	bool "DMA-BUF System Heap (cached + uncached)"
	depends on DMABUF_HEAPS
	default y
	help
	  Provides "system" and "system-uncached" heaps backed by buddy
	  allocator pages. This is the mandatory heap for Android
	  libdmabufheap.

config DMABUF_HEAPS_CMA
	bool "DMA-BUF CMA Heap"
	depends on DMABUF_HEAPS && DMA_CMA
	default y
	help
	  Provides "cma" heap backed by the default contiguous memory
	  area. Useful for large contiguous buffers.

config DMABUF_HEAPS_CARVEOUT
	bool "DMA-BUF Carveout Heap (reserved memory)"
	depends on DMABUF_HEAPS && OF && OF_RESERVED_MEM
	default y
	help
	  Provides dma_heaps backed by reusable reserved-memory regions.
	  Each heap is described by a devicetree node with compatible
	  "dma-heap-carveout", a memory-region phandle and a heap-name.
	  Regions without a kernel mapping (no-map) and secure regions
	  are intentionally not supported here; those stay ION-only.
	  See Documentation/devicetree/bindings/dma-heap-carveout.txt.

endmenu
```
